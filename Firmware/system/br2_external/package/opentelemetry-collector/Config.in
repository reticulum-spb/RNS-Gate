## Firmware/system/br2_external/package/opentelemetry-collector/Config.in
```kconfig
config BR2_PACKAGE_OPENTELEMETRY_COLLECTOR
	bool "opentelemetry-collector (otelarmv7col)"
	depends on BR2_USE_MMU
	depends on BR2_PACKAGE_HOST_GO_TARGET_ARCH_SUPPORTS
	select BR2_PACKAGE_HOST_GO
	help
	  Minimal OpenTelemetry Collector generated from builder-config.yaml
	  for Linux ARMv7. The collector contains the file storage and basic
	  authentication extensions, filelog and hostmetrics receivers, batch
	  and memory limiter processors, the OTLP/HTTP exporter, and the env
	  and file configuration providers.

	  The installed binary is /usr/bin/otelarmv7col.

	  https://github.com/open-telemetry/opentelemetry-collector-contrib
```

## Firmware/system/br2_external/package/reticulum-tnc/Config.in
```kconfig
config BR2_PACKAGE_RETICULUM_TNC
    bool "Reticulum-TNC"
    select BR2_PACKAGE_LIBCYAML
    select BR2_PACKAGE_ALSA_LIB
    select BR2_PACKAGE_FFTW
    select BR2_PACKAGE_FFTW_DOUBLE
    select BR2_PACKAGE_LIBGPIOD
    select BR2_PACKAGE_LIQUID_DSP
    help
      Reticulum modem daemon
```

## Firmware/system/br2_external/package/rs-lxmf/Config.in
```kconfig
config BR2_PACKAGE_RS_LXMF
    bool "rsLXMF"
    select BR2_PACKAGE_RS_RETICULUM
```

## Firmware/system/br2_external/package/rs-nodepage/Config.in
```kconfig
config BR2_PACKAGE_RS_NODEPAGE
    bool "rsNodePage"
    select BR2_PACKAGE_RS_RETICULUM
```

## Firmware/system/br2_external/package/rs-nomadnet/Config.in
```kconfig
config BR2_PACKAGE_RS_NOMADNET
    bool "rsNomadNet"
    select BR2_PACKAGE_RS_RETICULUM
    select BR2_PACKAGE_RS_LXMF
    select BR2_PACKAGE_RS_RRC_CLIENT
    help
        An local web client compatible with NomadNet, built on the
        sibling rsReticulum, rsLXMF, rsRRC, and rsRRC-client projects.
```

## Firmware/system/br2_external/package/rs-reticulum-modem/Config.in
```kconfig
config BR2_PACKAGE_RS_RETICULUM_MODEM
    bool "rsReticulum alsa modem plugin"
    select BR2_PACKAGE_LIBCYAML
    select BR2_PACKAGE_LIBGPIOD
    select BR2_PACKAGE_ALSA_LIB
    select BR2_PACKAGE_LIQUID_DSP
    help
      rsReticulum alsa modem plugin
```

## Firmware/system/br2_external/package/rs-reticulum-sx1262/Config.in
```kconfig
config BR2_PACKAGE_RS_RETICULUM_SX1262
    bool "rsReticulum SX1262 plugin"
    select BR2_PACKAGE_LIBCYAML
    select BR2_PACKAGE_LIBGPIOD
    help
      rsReticulum SX1262 plugin
```

## Firmware/system/br2_external/package/rs-rrc-client/Config.in
```kconfig
config BR2_PACKAGE_RS_RRC_CLIENT
    bool "rsRRC-client"
    select BR2_PACKAGE_RS_RRC
	help
        Reusable asynchronous RRC client built on rsReticulum. It is intended for
        interactive clients, services, and bots. It is the RRC transport/session layer
        used by the adjacent `rsNomadNet` web client.
```

## Firmware/system/br2_external/package/rs-rrc/Config.in
```kconfig
config BR2_PACKAGE_RS_RRC
    bool "rsRRC"
	help
        Shared Rust implementation of the Reticulum Relay Chat (RRC) version 1 wire protocol.
```

## Firmware/system/br2_external/package/rs-rrcd/Config.in
```kconfig
config BR2_PACKAGE_RS_RRCD
    bool "rsRRCD"
    select BR2_PACKAGE_RS_RRC
	help
        rsRRCD is a standalone RRC hub daemon (server) written in Rust
```
